## CMakeLists.txt
```
cmake_minimum_required(VERSION 3.28.0)

list(
    APPEND
        EXTRA_CONF_FILE
           ${CMAKE_CURRENT_SOURCE_DIR}/embedded-pio/zephyrcan/zephyrcan.conf
           ${CMAKE_CURRENT_SOURCE_DIR}/embedded-pio/updatemanager_eth/updatemanager_eth.conf
)

find_package(Zephyr REQUIRED HINTS $ENV{ZEPHYR_BASE})
project(PDC LANGUAGES C CXX)

target_include_directories(app PRIVATE include)


file(GLOB APP_SOURCES CONFIGURE_DEPENDS src/*.cpp)

target_sources(app PRIVATE ${APP_SOURCES})


 add_subdirectory(embedded-pio/zephyrcan)
  add_subdirectory(embedded-pio/updatemanager_eth)


 

target_link_libraries(app
      PRIVATE
          zephyrcan
          updatemanager_eth
  )
```

## sysbuild.conf
```
# Build and flash MCUboot alongside the application.
# This is what puts a bootloader at 0x08000000 and the signed app in slot0.
SB_CONFIG_BOOTLOADER_MCUBOOT=y
```

## prj.conf
```kconfig
CONFIG_LOG=y

CONFIG_CPP=y
CONFIG_STD_CPP17=y
CONFIG_GLIBCXX_LIBCPP=y
CONFIG_NEWLIB_LIBC=y
CONFIG_HEAP_MEM_POOL_SIZE=4096
CONFIG_GPIO=y
```

## src/main.cpp
```c
// sc2-pdc main: Power Distribution and Controls on Nucleo-L432KC
// Boot order: Serial, IO, speed calc, state machine - Loop sends CAN telem
// The state machine runs on a timer interrupt, not in loop()

#include "IOManagement.h"
#include "canPDC.h"
#include "const.h"
#include "motor_control.h"
#include "speed_calc.h"

// DEBUG_TECHNIQUE selects the operating mode:
// 0 = production (state machine and real IO)
// 1 = random CAN echo (no state machine, for bus tests)
#define DEBUG_TECHNIQUE 0

#if DEBUG_TECHNIQUE == 1
#include <stdlib.h>
int counter = 0;
#endif

CANPDC canBus(CAN1, DEF);

static const char *pdcStateToString(PDCStates state) {
  switch (state) {
  case PDCStates::OFF:
    return "OFF";
  case PDCStates::PARK:
    return "PARK";
  case PDCStates::IDLE:
    return "IDLE";
  case PDCStates::FORWARD:
    return "FORWARD";
  case PDCStates::REVERSE:
    return "REVERSE";
  default:
    return "UNKNOWN";
  }
}

#if DEBUG_TECHNIQUE == 1
void randomizeData();
void debugPrint();

void randomizeData() {
  acc_out = ((float)rand() / RAND_MAX);     // 0.0 to 1.0
  regen_brake = ((float)rand() / RAND_MAX); // 0.0 to 1.0
  lv_12V_telem =
      ((float)rand() / RAND_MAX) * 12.0; // 0 to 12 V after divider scaling
  lv_5V_telem = ((float)rand() / RAND_MAX) * 5.0;          // 0 to 5 V
  lv_5V_current = ((float)rand() / RAND_MAX) * 3.3;        // 0 to 3.3 V
  current_in_telem = ((float)rand() / RAND_MAX) * 3.3;     // 0 to 3.3 V
  brake_pressed = rand() % 2;
  digital_data.brake_led = brake_pressed;

  digital_data.direction = rand() % 2;
  digital_data.mc_speed_sig = rand() % 2;
  digital_data.eco_mode = rand() % 2;
  digital_data.mcu_mc_on = rand() % 2;
  digital_data.park_brake = rand() % 2;
}

void debugPrint() {
#ifdef DEBUG_PRINTS
  Serial.printf("acc_in: %f\n", acc_in);
  Serial.printf("acc_out: %f\n", acc_out);
  Serial.printf("regen_brake: %f\n", regen_brake);
  Serial.printf("lv_12V_telem: %f\n", lv_12V_telem);
  Serial.printf("lv_5V_telem: %f\n", lv_5V_telem);
  Serial.printf("lv_5V_current: %f\n", lv_5V_current);
  Serial.printf("current_in_telem: %f\n", current_in_telem);
  Serial.printf("brake_pressed: %i\n", brake_pressed);
  Serial.printf("brakeLED: %i\n", digital_data.brake_led);
  Serial.printf("digital_data.direction: %i\n", digital_data.direction);
  Serial.printf("digital_data.mc_speed_sig: %i\n", digital_data.mc_speed_sig);
  Serial.printf("digital_data.eco_mode: %i\n", digital_data.eco_mode);
  Serial.printf("digital_data.mcu_mc_on: %i\n", digital_data.mcu_mc_on);
  Serial.printf("digital_data.park_brake: %i\n", digital_data.park_brake);
#endif
}
#endif

void setup() {
  Serial.begin(115200);
#ifdef DEBUG_PRINTS
  Serial.printf("Starting up...\n");
#endif
  digitalWrite(PB6, HIGH);
  initIO();
  startSpeedCalculation();

#if DEBUG_TECHNIQUE == 0
  // Start PARK/IDLE/FORWARD/REVERSE on TIM2
  initPDCState();
#elif DEBUG_TECHNIQUE == 1
  // Seed with millis(), no real time clock so time(NULL) is always 0
  srand(millis());
  randomizeData();
#endif
}

void loop() {
#if DEBUG_TECHNIQUE == 0
  // State machine runs on its timer, loop() only sends CAN and reads RX
#ifdef DEBUG_PRINTS
  {
    static uint32_t lastDebugMs = 0;
    uint32_t nowMs = millis();
    if (nowMs - lastDebugMs >= 1000) {
      lastDebugMs = nowMs;
      Serial.printf(
          "state=%s can_dir=%s fr=%u acc_in_raw=%u "
          "acc_in=%.3f acc_out=%.3f regen=%.3f rpm=%.1f mph=%.1f "
          "brake=%u brake_v=%.3f park=%u mcu_dir=%u eco=%u brake_led=%u\n",
          pdcStateToString(get_state()),
          forwardAndReverse == FORWARD_VALUE ? "Fwd" : "Rev", forwardAndReverse,
          acc_in_raw, acc_in, acc_out, regen_brake, rpm, mph,
          brake_pressed, brake_pressure_telem, digital_data.park_brake,
          digital_data.direction, digital_data.eco_mode, digital_data.brake_led);
    }
  }
#endif
#elif DEBUG_TECHNIQUE == 1
  if (counter >= COUNTER_EXP) {
    randomizeData();
    debugPrint();
    counter = 0;
#ifdef DEBUG_PRINTS
    Serial.printf("Received forwardAndReverse: %i\n", forwardAndReverse);
#endif
  }
  counter++;
#endif

  canBus.sendPDCData();
  canBus.runQueue(DATA_SEND_PERIOD);
}
```

## include/IOManagement.h
```c
#ifndef __IO_MANAGER_H__
#define __IO_MANAGER_H__


#include "const.h"

// Outputs
#define MCU_DIR PB7
#define MCU_ECO PB1

// Inputs
#define MCU_MC_ON PA10
#define MCU_SPEED_SIG PA8
#define PRK_BRK_TELEM PB4
#define BRAKE_TELEM PA0

struct Digital_Data {
  bool direction : 1;    // output
  bool mc_speed_sig : 1; // input
  bool eco_mode : 1;     // output
  bool mcu_mc_on : 1;    // input (motor controller power signal)
  bool park_brake : 1;   // always false in production (sensor removed)
  bool brake_led : 1;    // output (pedal brake or regen >= threshold)
};

// Shared telem: IOManagement owns most but speed_calc writes rpm and mph
extern volatile Digital_Data digital_data;

extern volatile uint16_t acc_in_raw;
extern volatile float acc_in;
extern volatile float acc_out;
extern volatile float regen_in;
extern volatile float regen_brake;
extern volatile float lv_12V_telem;
extern volatile float lv_5V_telem;
extern volatile float lv_5V_current;
extern volatile float current_in_telem;
extern volatile bool brake_pressed;
extern volatile float brake_pressure_telem;
extern volatile float mph;
extern volatile float rpm;

void initIO();
void readIO();
void set_direction(bool dir);
void set_eco_mode(bool eco);
void writeAccOut(float newAccOut);
void writeRegenBrake(float newRegenBrake);

#endif
```

## include/analog.h
```c
// #ifndef __ANALOG_H__
// #define __ANALOG_H__

// float acc_out;
// float regen_brake;

// float lv_12V_telem;
// float lv_5V_telem;
// float lv_5V_current;
// float current_in_telem;
// float brake_pressure_telem;

// void readAnalog();

// void initAnalog();


// #endif
```

## include/analogPins.h
```c
#ifndef __ANALOG_H__
#define __ANALOG_H__

#include "adc.h"
#include "const.h"
#include "STM32TimerInterrupt_Generic.h"

extern volatile float acc_out;
extern volatile float regen_brake;

extern volatile float lv_12V_telem;
extern volatile float lv_5V_telem;
extern volatile float lv_5V_current;
extern volatile float current_in_telem;
extern volatile float brake_pressure_telem;
extern volatile float acc_in;

void initAnalog();

void readAnalog();

void writeAccOut(float newAccOut);

void writeRegenBrake(float newRegenBrake);

#endif
```

## include/board_config.h
```c
#ifndef __BOARD_CONFIG_H__
#define __BOARD_CONFIG_H__

#include "adc.h"

// ------------- TIMING -------------
#define IO_UPDATE_PERIOD 50000  // us
#define PID_UPDATE_INTERVAL ((float)IO_UPDATE_PERIOD / 1000000.0f)
#define DATA_SEND_PERIOD 50  // ms, CAN TX (+ debug if on)
#define COUNTER_EXP 2

// ------------- DEBUG -------------
// 0 off (not in flash) | 1 human
#define SC2_DEBUG 0

// ------------- TEST -------------
// Uncomment for can-bounce test board (park_brake from CAN).
// #define TEST_MODE

// ------------- IO PINS -------------
#define MCU_DIR PB7
#define MCU_ECO PB1
#define MCU_MC_ON PA10
#define MCU_SPEED_SIG PA8
#define PRK_BRK_TELEM PB4
#define BRAKE_TELEM PA0

#define INA180_CURRENT_MULTIPLIER 10

// ------------- PID (reserved) -------------
#define POWER_P_PARAM 0.0
#define POWER_I_PARAM 0.0
#define POWER_D_PARAM 0.0
#define SPEED_P_PARAM 2.5
#define SPEED_I_PARAM 0.0
#define SPEED_D_PARAM 0.0

#define MIN_POWER 0.0
#define MAX_POWER 1.0
#define MIN_RPM 0.0
#define MAX_RPM 1000.0
#define MIN_OUT 0.0
#define MAX_OUT 1.0

// ------------- STATE MACHINE -------------
enum class PDCStates : uint8_t {
    OFF,
    PARK,
    IDLE,
    FORWARD,
    REVERSE,
};

extern volatile PDCStates pdcState;

#define FORWARD_VALUE 0
#define REVERSE_VALUE 1

// ------------- SPEED / BRAKE -------------
#define MIN_MOVING_SPEED 3.0  // mph threshold for idle state
#define REGEN_BRAKE_LIGHT_THRESHOLD 0.05f
#define BRAKE_DEBOUNCE_PRESS_SAMPLES 3    // ~150 ms at 50 ms IO period
#define BRAKE_DEBOUNCE_RELEASE_SAMPLES 2  // ~100 ms
#define BRAKE_ADC_CHANNEL ADC_CHANNEL_5
#define BRAKE_PRESSURE_THRESHOLD_V 1.65f

#define SPEED_CALC_INTERVAL_US 50000  // us
#define ARRAY_SIZE 20
#define PULSES_PER_REV 48
#define WHEEL_CIRCUMFERENCE 69  // inches

#endif  // __BOARD_CONFIG_H__
```

## include/canPDC.h
```c
#ifndef __CAN_PDC_H__
#define __CAN_PDC_H__

#include "IOManagement.h"
#include "zephyrcan.h"

// Macros for the CAN message IDs
#define FORWARD_AND_REVERSE_ID 0x300
#define REGEN_BRAKE_INPUT_ID 0x301
#define THROTTLE_INPUT_ID 0x302
#define DRIVE_MODE_INPUT_ID 0x303


const uint8_t ARR_IDS [] =  {FORWARD_AND_REVERSE_ID, REGEN_BRAKE_INPUT_ID, THROTTLE_INPUT_ID, DRIVE_MODE_INPUT_ID};  

class CANPDC : public ZephyrCAN {
public:
  CANPDC(CAN_TypeDef *canPort, CAN_PINS pins, int frequency = DEFAULT_CAN_FREQ);
  void readHandler(struct can_frame * msg);
  void sendPDCData();
};

extern volatile bool forwardAndReverse;

#endif
```

## include/can_pdc.h
```c
#ifndef __CAN_PDC_H__
#define __CAN_PDC_H__

#include "canmanager.h"
#include "io_management.h"

// ------------- CLASS -------------

// IDs / DLCs from embedded-pio/can_ids.h (CAN_*)
class CanPdc : public CANManager {
   public:
    CanPdc(CAN_TypeDef* canPort, CAN_PINS pins, int frequency = DEFAULT_CAN_FREQ);
    void readHandler(CAN_message_t msg) override;
    void sendPDCData();
};

extern volatile bool forwardAndReverse;

#endif  // __CAN_PDC_H__
```

## include/const.h
```c
#ifndef __CONST_H__
#define __CONST_H__
#include <stdint.h>

/**
 * Debugging Techniques:
 * 1. Send random data over CAN and verify if you received the same random data
 */

// Uncomment when building for the can-bounce test board
// #define TEST_MODE

// Uncomment to enable Serial debug prints/comment for production
// to save CPU cycles and reduce latency
#define DEBUG_PRINTS

// Timing constants
#define COUNTER_EXP 2
#define IO_UPDATE_PERIOD 50000 // us
#define DATA_SEND_PERIOD 50     // CAN TX period (ms); also debug print period

// Analog scaling
#define INA180_CURRENT_MULTIPLIER 10 // multiplies analog current telem to convert it into a readable value

// State machine
enum class PDCStates : uint8_t {
  OFF,
  PARK,
  IDLE,
  FORWARD,
  REVERSE,
};

extern volatile PDCStates pdcState;

#define FORWARD_VALUE 0
#define REVERSE_VALUE 1

#define MIN_MOVING_SPEED 3.0 // rpm threshold to leave IDLE

// Brake
#define REGEN_BRAKE_LIGHT_THRESHOLD 0.05f // 5% regen turns brake lights on

// Stable IO samples -> (IO_UPDATE_PERIOD = 50 ms) before brake state changes
#define BRAKE_DEBOUNCE_PRESS_SAMPLES 3   // ~150 ms to assert
#define BRAKE_DEBOUNCE_RELEASE_SAMPLES 2 // ~100 ms to release

#endif
```

## include/debug.h
```c
#ifndef __DEBUG_H__
#define __DEBUG_H__

#include "board_config.h"

// ------------- FUNCTIONS -------------

#if SC2_DEBUG

void debugInit();
void debugUpdate();
void debugError(const char* msg);

#else

// no-ops when SC2_DEBUG is 0 (not linked into flash)
inline void debugInit() {}
inline void debugUpdate() {}
inline void debugError(const char*) {}

#endif

#endif  // __DEBUG_H__
```

## include/digital.h
```c
#ifndef __DIGITAL_H__
#define __DIGITAL_H__


//Define macros for the digital pins

//Outputs
#define MCU_DIR             PA_6
#define MCU_ECO             PB_1
#define MCU_MC_ON           PA_2

//Inputs
#define MCU_SPEED_SIG       PA_8
#define PRK_BRK_TELEM       PB_4

#define IO_UPDATE_PERIOD    100000 // 0.1 second

struct Digital_Data {
    bool direction : 1;         // output
    bool mc_speed_sig : 1;      // input
    bool eco_mode : 1;          // output
    bool mc_on : 1;             // output
    bool park_brake : 1;        // input
};

extern volatile Digital_Data digital_data;

// read all the digital inputs
void readDigital();

// initialize all the digital pins
void initDigital();

// Set the value of output pins
void setDirection(bool dir);
void setEcoMode(bool eco);
void setMCOn(bool mc_on);

#endif
```

## include/digitalPins.h
```c
#ifndef __DIGITAL_H__
#define __DIGITAL_H__

#include "ina281.h"
#include "PID.h"

//Outputs
#define MCU_DIR                PA_6
#define MCU_ECO                PB_1
#define MC_ON                  PA_10

//Inputs
#define MCU_SPEED_SIG          PA_8
#define PRK_BRK_TELEM          PB_4

struct Digital_Data {
    bool mc_on : 1;             // input  
    bool direction : 1;         // output
    bool mc_speed_sig : 1;      // input
    bool eco_mode : 1;          // output
    bool park_brake : 1;        // input
};

extern volatile Digital_Data digital_data;

// read all the digital inputs
void read_digital();

// initialize all the digital pins
void init_digital();

// Set the value of output pins
void set_direction(bool dir);
void set_eco_mode(bool eco);

#endif
```

## include/io_management.h
```c
#ifndef __IO_MANAGEMENT_H__
#define __IO_MANAGEMENT_H__

#include <Arduino.h>
#include <HardwareTimer.h>
#ifndef MICROSEC_FORMAT
#define MICROSEC_FORMAT TimerFormat_t::MICROSEC_FORMAT
#endif
#include "STM32TimerInterrupt_Generic.h"
#include "adc.h"
#include "board_config.h"

// ------------- TYPES -------------

struct Digital_Data {
    bool direction : 1;
    bool mc_speed_sig : 1;
    bool eco_mode : 1;
    bool mcu_mc_on : 1;
    bool park_brake : 1;
    bool brake_led : 1;
};

// ------------- GLOBALS -------------

extern volatile Digital_Data digital_data;

extern volatile uint16_t acc_in_raw;
extern volatile float acc_in;
extern volatile float acc_out;
extern volatile float regen_in;
extern volatile float regen_brake;
extern volatile float lv_12V_telem;
extern volatile float lv_5V_telem;
extern volatile float lv_5V_current;
extern volatile float current_in_telem;
extern volatile bool brake_pressed;
extern volatile float brake_pressure_telem;
extern volatile float mph;
extern volatile float rpm;

// ------------- FUNCTIONS -------------

void initIO();
void initSpeedCounter();
void readIO();
void set_direction(bool dir);
void set_eco_mode(bool eco);
void writeAccOut(float newAccOut);
void writeRegenBrake(float newRegenBrake);

#endif  // __IO_MANAGEMENT_H__
```

## include/motor_control.h
```c
#ifndef __MOTOR_CONTROL_H__
#define __MOTOR_CONTROL_H__

#include "const.h"
#include "IOManagement.h"
#include "canPDC.h"

void initPDCState();
void transition();
PDCStates get_state();

#endif
```
